#include <behaviors.dtsi>
#include <dt-bindings/zmk/keys.h>
#include <dt-bindings/zmk/bt.h>

#define DEFAULT 0

#define COMBO_TIMEOUT 50

/ {
    keymap {
        compatible = "zmk,keymap";

        default_layer {
            bindings = <
                          &kp Q    
            >;
        };
    };
};