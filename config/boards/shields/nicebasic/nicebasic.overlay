#include <dt-bindings/zmk/matrix_transform.h>

/ {
    chosen {
        zmk,kscan = &kscan;
        zmk,matrix_transform = &transform;
    };

    kscan: kscan {
        compatible = "zmk,kscan-gpio-matrix";
        label = "KSCAN";
        diode-direction = "col2row";

        row-gpios = <&pro_micro 10 (GPIO_ACTIVE_HIGH | GPIO_PULL_DOWN)>;

        col-gpios = <&pro_micro 9 (GPIO_ACTIVE_HIGH)>;
    };

    transform: matrix_transform {
        compatible = "zmk,matrix-transform";
        rows = <2>;
        columns = <1>;

        map = <
                     RC(0, 0)  
        >;
    };
};